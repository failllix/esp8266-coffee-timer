#include <Adafruit_MPU6050.h>
#include <Adafruit_Sensor.h>
#include <Wire.h>
#include "SSD1306Wire.h" // legacy include: `#include "SSD1306.h"`

// Initialize the OLED display using Wire library
SSD1306Wire display(0x3c, SDA, SCL);
// Initialize the Gyroscope
Adafruit_MPU6050 mpu;

// Timer
long timerStart = 0;
long myTimer = 0;
float seconds = 0;

double minAcc = 1000;
double maxAcc = -1000;
double accDifference = 0;

//time between evaluating min and max acc of period
int measurementInterval = 100;

//keeping track of measurement interval
long intervalStart = 0;
int intervalCounter = 0;

//total measured acc during interval
double totalMeasurementAcc = 0;

//average of measured acc during interval
double measurementDecisionAcc = 0;
//check average after x intervals
int intervalThr = 2;

//threshold (of average measured acc) to be passed after x intervals
int measurementThr = 20;

//timer state
bool timerRunningBefore = false;
bool timerRunning = false;

// Created by http://oleddisplay.squix.ch/ Consider a donation
// In case of problems make sure that you are using the font file with the correct version!
const uint8_t Lato_Regular_34[] PROGMEM = {
  0x23, // Width: 35
  0x2A, // Height: 42
  0x20, // First Char: 32
  0xE0, // Numbers of Chars: 224

  // Jump Table:
  0xFF, 0xFF, 0x00, 0x09,  // 32:65535
  0x00, 0x00, 0x29, 0x09,  // 33:0
  0x00, 0x29, 0x39, 0x0D,  // 34:41
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  0x55, 0xEC, 0x63, 0x12,  // 255:21996

  // Font Data:
  0x00,0x00,0x00,0x00,0x00,0x00,0x00,0x00,0x00,0x00,0x00,0x00,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0x01, // 33
  0x00,0x00,0x00,0x00,0x00,0x00,0x00,0x00,0x00,0x00,0x00,0x00,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0x03, // 34
  0x00,0x00,0x00,0x00,0x00,0x00,0x00,0x00,0x00,0x03,0x00,0x00,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0x03, // 35
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  0x00,0x00,0x01,0x00,0x00,0x00,0x00,0x00,0x07,0x00,0x00,0x00,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0x00,0x03  // 255
};

void setup() {
  Serial.begin(115200);
  while (!Serial)
    delay(10); // will pause Zero, Leonardo, etc until serial console opens

  // Try to initialize!
  if (!mpu.begin()) {
    Serial.println("Failed to find MPU6050 chip");
    while (1) {
      delay(10);
    }
  }

  mpu.setAccelerometerRange(MPU6050_RANGE_2_G);
  mpu.setGyroRange(MPU6050_RANGE_500_DEG);
  mpu.setFilterBandwidth(MPU6050_BAND_260_HZ);
  delay(100);

  display.init();
  display.displayOn();

  display.setContrast(255);
  
  delay(1000);
  display.clear();
  timerStart = millis();
  intervalStart = millis();
}

void loop() {
  display.clear();
  /* Get new sensor events with the readings */
  sensors_event_t a, g, temp;
  mpu.getEvent(&a, &g, &temp);

  double acc = fabs(a.acceleration.x) + fabs(a.acceleration.y) + fabs(a.acceleration.z);
  acc = pow(acc, 2);

  if(acc > maxAcc){
    maxAcc = acc;
  }

  if(acc < minAcc){
    minAcc = acc;
  }

  
  myTimer = millis() - timerStart;

  if(timerRunning){
    seconds = float(myTimer) / float(1000);
  }

  if(millis() - intervalStart > measurementInterval){
    intervalStart = millis();
    accDifference = maxAcc - minAcc;
    minAcc = 1000;
    maxAcc = -1000;
    totalMeasurementAcc += accDifference;
    intervalCounter++;
  }

  if(intervalCounter > intervalThr){
    intervalCounter = 0;
    measurementDecisionAcc = totalMeasurementAcc / float(intervalThr);
    if(measurementDecisionAcc > measurementThr){
      timerRunning = true;
      if(!timerRunningBefore){
          timerStart = millis();
      }
    } else {
      timerRunning = false;
    }
    totalMeasurementAcc = 0;
    timerRunningBefore = timerRunning;
  }
  
  Serial.print("accelaration:");
  Serial.print(acc);
  Serial.print(",accelaration_diff:");
  Serial.print(accDifference);
  Serial.print(",accelaration_interval_avg:");
  Serial.println(measurementDecisionAcc);
  
  // Print to the screen
  display.setFont(Lato_Regular_34);
  display.setTextAlignment(TEXT_ALIGN_LEFT);
  display.drawString(10, 0, String(seconds, 2));
  display.display();
}
